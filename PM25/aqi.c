#include "config.h"

uint16 const aqi_table_china[501] = 
{
0	,
3 	,
4 	,
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499	,
500	
};	

uint16 const aqi_table_usa[501] = 
{
0	,
4	,
8	,
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499	,
500	
};


uint16 aqi_table_customer[5] = {12, 35, 55, 150, 250};

void get_aqi_value(uint16 PM_val, uint16 *AQI_val,uint8 *AQI_level)
{
	PM_val /=10;
	if(PM_val < AQI_INDEX_RNG) 
	{
		if(pm25_sensor.AQI_area == 1)
			*AQI_val = aqi_table_china[PM_val];
		else if(pm25_sensor.AQI_area == 2)
		{
			if(PM_val<aqi_table_customer[0])
			{
				*AQI_val = ((500/12) * PM_val) /10;
			}
			else if(PM_val<aqi_table_customer[1])
			{
				*AQI_val = (((PM_val-aqi_table_customer[0])*500)/(aqi_table_customer[1]-aqi_table_customer[0]))/10+50;
			}
			else if(PM_val<aqi_table_customer[2])
			{
				*AQI_val = (((PM_val-aqi_table_customer[1])*500)/(aqi_table_customer[2]-aqi_table_customer[1]))/10+100;
			}
			else if(PM_val<aqi_table_customer[3])
			{
				*AQI_val = (((PM_val-aqi_table_customer[2])*500)/(aqi_table_customer[3]-aqi_table_customer[2]))/10+150;
			}
			else if(PM_val<aqi_table_customer[4])
			{
				*AQI_val = (((PM_val-aqi_table_customer[3])*500)/(aqi_table_customer[4]-aqi_table_customer[3]))/10+200;
			}
			else
			{
				*AQI_val = (((PM_val-aqi_table_customer[4])*500)/(500-aqi_table_customer[4]))/10+300;
			}
		}
		else
			*AQI_val = aqi_table_usa[PM_val];
	}
	else 
		*AQI_val = PM_val;
	
	if(*AQI_val < LEVEL0) *AQI_level = GOOD;
	else if(*AQI_val < LEVEL1) *AQI_level = MODERATE;
	else if(*AQI_val < LEVEL2 ) *AQI_level = POOL_FOR_SOME;
	else if(*AQI_val < LEVEL3 ) *AQI_level = UNHEALTHY;
	else if(*AQI_val < LEVEL4) *AQI_level = MORE_UNHEALTHY;
	else   *AQI_level = HAZARDOUS; 

}
